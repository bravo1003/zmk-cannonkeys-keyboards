/*
 * Copyright (c) 2020 The ZMK Contributors
 *
 * SPDX-License-Identifier: MIT
 */


#include <dt-bindings/zmk/behaviors.h>
#include <dt-bindings/zmk/keys.h>

/ {
    behaviors {
#if ZMK_BEHAVIOR_OMIT(TILDEESC)
        /omit-if-no-ref/
#endif
        tildeesc: tilde_escape {
            compatible = "zmk,behavior-mod-morph";
            #binding-cells = <0>;
            bindings = <&kp ESC>, <&kp TILDE>;
            mods = <(MOD_LSFT|MOD_RSFT)>;
            display-name = "Tilde/Escape";
        };
    };
};
